#include "lism.dtsi"

&transform_keymap {
    col-offset = <5>;
};


/ {

    chosen {
        zmk,battery = &vbatt;
    };

    vbatt: vbatt {
        compatible = "zmk,battery-voltage-divider";
        io-channels = <&adc 7>;
        power-gpios = <&gpio0 14 (GPIO_OPEN_DRAIN | GPIO_ACTIVE_LOW)>;
        output-ohms = <469200>;
        full-ohms = <(1000000 + 469200)>;
    };

};

